## 2.Semester-serial_crypto/DIC-serial-crypto-Programm/Programm/build/Kconfig/Kconfig.modules
```kconfig
menu "hal_nordic (/home/peppi/zephyrproject/modules/hal/nordic)"
osource "$(ZEPHYR_HAL_NORDIC_KCONFIG)"
config ZEPHYR_HAL_NORDIC_MODULE
	bool
	default y
endmenu
menu "sof (/home/peppi/zephyrproject/modules/audio/sof)"
osource "/home/peppi/zephyrproject/modules/audio/sof/zephyr/Kconfig"
config ZEPHYR_SOF_MODULE
	bool
	default y
endmenu
menu "trusted-firmware-m (/home/peppi/zephyrproject/modules/tee/tfm)"
osource "$(ZEPHYR_TRUSTED_FIRMWARE_M_KCONFIG)"
config ZEPHYR_TRUSTED_FIRMWARE_M_MODULE
	bool
	default y
endmenu
```

## 2.Semester-serial_crypto/DIC-serial-crypto-Programm/Programm/build/Kconfig/Kconfig.shield
```kconfig
osource "/home/peppi/zephyrproject/zephyr/boards/shields/*/Kconfig.shield"
osource "/home/peppi/zephyrproject/zephyr/boards/shields/*/Kconfig.shield"
```

## 2.Semester-serial_crypto/DIC-serial-crypto-Programm/Programm/build/Kconfig/Kconfig.shield.defconfig
```kconfig
osource "/home/peppi/zephyrproject/zephyr/boards/shields/*/Kconfig.defconfig"
osource "/home/peppi/zephyrproject/zephyr/boards/shields/*/Kconfig.defconfig"
```

## 2.Semester-serial_crypto/DIC-serial-crypto-Programm/Programm/build/Kconfig/Kconfig.soc.arch
```kconfig
osource "/home/peppi/zephyrproject/zephyr/soc/$(ARCH)/Kconfig"
osource "/home/peppi/zephyrproject/zephyr/soc/$(ARCH)/*/Kconfig"
```
